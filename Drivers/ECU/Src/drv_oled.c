/**
 * drv_oled.c — Driver OLED SSD1315/SSD1306 128×64, I2C software (bit-bang).
 *
 * Bare-metal, sem HAL. Acesso direto aos registradores GPIO.
 * Pinos: OLED_SCL=PC0, OLED_SDA=PC1 (definidos em pinout.h).
 *
 * DRV_OLED_Init() reconfigura PC0 e PC1 como GPIO saída push-pull,
 * independentemente de como estavam configurados (ADC analógico em modo ECU).
 *
 * Delay de I2C: usa DWT_CYCCNT (habilitado em main.c/_dwt_init antes de Init).
 * Velocidade: ~100 kHz (delay de 5 µs por borda).
 */

#include "drv_oled.h"
#include "pinout.h"
#include "ecu_config.h"
#include <string.h>

/* ----------------------------------------------------------------
 * Delay preciso via DWT_CYCCNT
 * Requer que main.c/_dwt_init() tenha sido chamado antes.
 * ---------------------------------------------------------------- */
#define DWT_CYCCNT_REG  (*((volatile uint32_t *)0xE0001004UL))

static void _delay_us(uint32_t us)
{
    uint32_t start = DWT_CYCCNT_REG;
    uint32_t wait  = us * (ECU_SYSCLOCK_HZ / 1000000UL);
    while ((DWT_CYCCNT_REG - start) < wait) {}
}

/* ----------------------------------------------------------------
 * Software I2C — primitivas
 * ---------------------------------------------------------------- */
#define _SCL_HI()   GPIO_SET(OLED_SCL_PORT, OLED_SCL_PIN)
#define _SCL_LO()   GPIO_CLR(OLED_SCL_PORT, OLED_SCL_PIN)
#define _SDA_HI()   GPIO_SET(OLED_SDA_PORT, OLED_SDA_PIN)
#define _SDA_LO()   GPIO_CLR(OLED_SDA_PORT, OLED_SDA_PIN)

static void _i2c_start(void)
{
    _SDA_HI(); _SCL_HI(); _delay_us(5U);
    _SDA_LO();             _delay_us(5U);  /* SDA↓ com SCL↑ = START */
    _SCL_LO();             _delay_us(5U);
}

static void _i2c_stop(void)
{
    _SDA_LO(); _SCL_HI(); _delay_us(5U);
    _SDA_HI();             _delay_us(5U);  /* SDA↑ com SCL↑ = STOP */
}

static void _i2c_write_byte(uint8_t b)
{
    for (int8_t i = 7; i >= 0; i--) {
        if (b & (1U << i)) { _SDA_HI(); } else { _SDA_LO(); }
        _delay_us(2U);
        _SCL_HI(); _delay_us(5U);
        _SCL_LO(); _delay_us(3U);
    }
    /* Pulso de clock para ACK (não lemos — master-only) */
    _SDA_HI(); _delay_us(2U);
    _SCL_HI(); _delay_us(5U);
    _SCL_LO(); _delay_us(3U);
}

/* Envia ctrl + buf em uma transação I2C */
static void _oled_write(uint8_t ctrl, const uint8_t *buf, uint16_t len)
{
    _i2c_start();
    _i2c_write_byte((uint8_t)(OLED_I2C_ADDR << 1U));
    _i2c_write_byte(ctrl);
    for (uint16_t i = 0U; i < len; i++) {
        _i2c_write_byte(buf[i]);
    }
    _i2c_stop();
}

static void _oled_cmd(uint8_t cmd)
{
    _oled_write(0x00U, &cmd, 1U);  /* D/C# = 0 → comando */
}

/* ----------------------------------------------------------------
 * Framebuffer: 8 páginas × 128 colunas = 1024 bytes
 * ---------------------------------------------------------------- */
static uint8_t s_fb[OLED_PAGES][OLED_WIDTH];

/* ----------------------------------------------------------------
 * Fonte 6×8 — ASCII 0x20-0x7F, domínio público.
 * 6 bytes/char = 6 colunas de 8 pixels (bit0 = pixel superior).
 * ---------------------------------------------------------------- */
static const uint8_t s_font6x8[96][6] = {
    {0x00,0x00,0x00,0x00,0x00,0x00}, /* 0x20 ' ' */
    {0x00,0x00,0x5F,0x00,0x00,0x00}, /* 0x21 '!' */
    {0x00,0x07,0x00,0x07,0x00,0x00}, /* 0x22 '"' */
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    {0x00,0x00,0x00,0x00,0x00,0x00}, /* 0x7F DEL  */
};

/* ----------------------------------------------------------------
 * Inicialização dos pinos I2C como GPIO saída push-pull
 * ---------------------------------------------------------------- */
static void _gpio_init(void)
{
    /* Clock GPIOC — bit 2 em RCC_AHB2ENR */
    volatile uint32_t *RCC_AHB2ENR = (volatile uint32_t *)0x4002104CUL;
    *RCC_AHB2ENR |= (1U << 2U);

    /* PC0 = SCL: output push-pull, very high speed, sem pull */
    OLED_SCL_PORT->MODER  = (OLED_SCL_PORT->MODER  & ~(3U << (OLED_SCL_PIN * 2U)))
                           | (1U << (OLED_SCL_PIN * 2U));
    OLED_SCL_PORT->OTYPER &= ~(1U << OLED_SCL_PIN);
    OLED_SCL_PORT->OSPEEDR|=  (3U << (OLED_SCL_PIN * 2U));
    OLED_SCL_PORT->PUPDR  &= ~(3U << (OLED_SCL_PIN * 2U));

    /* PC1 = SDA: output push-pull, very high speed, sem pull */
    OLED_SDA_PORT->MODER  = (OLED_SDA_PORT->MODER  & ~(3U << (OLED_SDA_PIN * 2U)))
                           | (1U << (OLED_SDA_PIN * 2U));
    OLED_SDA_PORT->OTYPER &= ~(1U << OLED_SDA_PIN);
    OLED_SDA_PORT->OSPEEDR|=  (3U << (OLED_SDA_PIN * 2U));
    OLED_SDA_PORT->PUPDR  &= ~(3U << (OLED_SDA_PIN * 2U));

    _SCL_HI(); _SDA_HI();
    _delay_us(10U);
}

/* ----------------------------------------------------------------
 * API pública
 * ---------------------------------------------------------------- */
void DRV_OLED_Init(void)
{
    _gpio_init();
    _delay_us(10000U);  /* aguarda OLED estabilizar após power-on */

    static const uint8_t init_seq[] = {
        0xAE,        /* Display OFF                  */
        0xD5, 0x80,  /* Clock divide / oscilador     */
        0xA8, 0x3F,  /* Multiplex ratio = 64-1       */
        0xD3, 0x00,  /* Display offset = 0           */
        0x40,        /* Start line = 0               */
        0x8D, 0x14,  /* Charge pump ON               */
        0x20, 0x00,  /* Horizontal addressing mode   */
        0xA1,        /* Segment remap col127→SEG0    */
        0xC8,        /* COM output scan reverso      */
        0xDA, 0x12,  /* COM pins configuration       */
        0x81, 0xCF,  /* Contraste = 207              */
        0xD9, 0xF1,  /* Pre-charge period            */
        0xDB, 0x40,  /* VCOMH deselect level         */
        0xA4,        /* Output segue RAM             */
        0xA6,        /* Normal (não invertido)       */
        0x2E,        /* Desativa scroll              */
        0xAF,        /* Display ON                   */
    };

    for (uint8_t i = 0U; i < (uint8_t)sizeof(init_seq); i++) {
        _oled_cmd(init_seq[i]);
    }

    DRV_OLED_Clear();
    DRV_OLED_Flush();
}

void DRV_OLED_Clear(void)
{
    memset(s_fb, 0x00, sizeof(s_fb));
}

void DRV_OLED_Print(uint8_t col_px, uint8_t row, const char *str)
{
    if (!str || row >= OLED_PAGES) return;
    uint8_t x = col_px;

    while (*str && x < OLED_WIDTH) {
        uint8_t ch = (uint8_t)*str++;
        if (ch < 0x20U || ch > 0x7FU) ch = 0x20U;
        const uint8_t *glyph = s_font6x8[ch - 0x20U];
        for (uint8_t c = 0U; c < OLED_CHAR_W && x < OLED_WIDTH; c++, x++) {
            s_fb[row][x] = glyph[c];
        }
    }
}

void DRV_OLED_InvertRow(uint8_t row)
{
    if (row >= OLED_PAGES) return;
    for (uint8_t c = 0U; c < OLED_WIDTH; c++) {
        s_fb[row][c] ^= 0xFFU;
    }
}

void DRV_OLED_Flush(void)
{
    /* Define janela: colunas 0-127, páginas 0-7 */
    _oled_cmd(0x21U); _oled_cmd(0x00U); _oled_cmd(0x7FU);
    _oled_cmd(0x22U); _oled_cmd(0x00U); _oled_cmd(0x07U);

    /* Envia cada página em uma transação I2C */
    for (uint8_t page = 0U; page < OLED_PAGES; page++) {
        _oled_write(0x40U, s_fb[page], OLED_WIDTH);  /* D/C#=1 → dados */
    }
}
